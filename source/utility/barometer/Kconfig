## source/utility/barometer/Kconfig
```kconfig
menu "Barometer Driver"

    choice BARO_CHOICE
        prompt "Barometer Chip Selection"
        default MS5611
        help
            This helps to choose Barometer host stack

        config MS5611
            bool "MS5611"

        config BMP280
            bool "BMP280"
    endchoice

    choice BARO_PROTOCAL
        prompt "Barometer Connection Protocol"
        default BARO_SPI
        help
            This helps to choose BARO connection protocol

        config BARO_I2C
            bool "BARO_I2C"

        config BARO_SPI
            bool "BARO_SPI"
    endchoice

endmenu
```

## source/utility/compass/Kconfig
```kconfig
menu "Compass Driver"

    choice COMPASS_CHOICE
        prompt "Compass Chip Selection"
        default QMC5883L
        help
            This helps to choose Compass host stack

        config QMC5883L
            bool "QMC5883L"

        config LIS3MDL
            bool "LIS3MDL"
    endchoice

    choice COMPASS_RROTOCAL
        prompt "Compass Connection Protocol"
        default COMPASS_I2C
        help
            This helps to choose Compass connection protocol

        config COMPASS_I2C
            bool "COMPASS_I2C"

        config COMPASS_SPI
            bool "COMPASS_SPI"
    endchoice

endmenu
```
